## firmware/sdkconfig.defaults.os
```kconfig
# Extra defaults for the OS app (LVGL + esp_lvgl_port). Selected per env via
# -DSDKCONFIG_DEFAULTS="sdkconfig.defaults;sdkconfig.defaults.os".
CONFIG_ESP_MAIN_TASK_STACK_SIZE=8192

# LVGL 9
CONFIG_LV_COLOR_DEPTH_16=y
CONFIG_LV_USE_CLIB_MALLOC=y
CONFIG_LV_USE_CLIB_STRING=y
CONFIG_LV_USE_CLIB_SPRINTF=y
CONFIG_LV_DEF_REFR_PERIOD=16
CONFIG_LV_USE_SNAPSHOT=y
CONFIG_LV_FONT_MONTSERRAT_14=y
CONFIG_LV_FONT_MONTSERRAT_20=y
CONFIG_LV_FONT_MONTSERRAT_28=y
CONFIG_LV_FONT_MONTSERRAT_48=y
CONFIG_LV_USE_LOG=y
CONFIG_LV_LOG_LEVEL_WARN=y
```
